## boards/shields/phannyball/Kconfig.shield
```kconfig
config SHIELD_PHANNYBALL_LEFT
    def_bool $(shields_list_contains,phannyball_left)
  
config SHIELD_PHANNYBALL_RIGHT
    def_bool $(shields_list_contains,phannyball_right)
  
```
